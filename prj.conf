## CMakeLists.txt
```
cmake_minimum_required(VERSION 3.20.0)

set(SHIELD ssd1306_128x64)
find_package(Zephyr REQUIRED HINTS $ENV{ZEPHYR_BASE})
project(tlamp)

#list(APPEND BOARD_ROOT ${CMAKE_CURRENT_SOURCE_DIR}/Users/caiodias/Documents/GitHub/tlamp_main_car_9160)

# APP START
target_sources(app PRIVATE src/main.c)
# APP END

# Include source directory
target_include_directories(app PRIVATE src)
target_include_directories(app PRIVATE include)
target_include_directories(app PRIVATE src/modules)

# Application directories
add_subdirectory(src/modules)
```

## prj.conf
```kconfig
#Memory Configs
CONFIG_MAIN_STACK_SIZE=8192
CONFIG_HEAP_MEM_POOL_SIZE=16384
CONFIG_SYSTEM_WORKQUEUE_STACK_SIZE=2048
CONFIG_AT_MONITOR_HEAP_SIZE=1024
CONFIG_HW_STACK_PROTECTION=y

#LVGL Memory Configs
CONFIG_LV_Z_MEM_POOL_NUMBER_BLOCKS=8
CONFIG_LV_Z_SHELL=y

# Display Options
CONFIG_I2C=y
CONFIG_DISPLAY=y
CONFIG_SSD1306=y
CONFIG_SSD1306_SH1106_COMPATIBLE=y
CONFIG_SSD1306_DEFAULT=y
CONFIG_SSD1306_REVERSE_MODE=y
CONFIG_DISPLAY_LOG_LEVEL_ERR=y

CONFIG_LOG=y
CONFIG_SHELL=y

CONFIG_LVGL=y
CONFIG_LV_MEM_CUSTOM=y
CONFIG_LV_USE_LOG=y
CONFIG_LV_USE_LABEL=y
CONFIG_LV_USE_BTN=y
CONFIG_LV_USE_IMG=y
CONFIG_LV_USE_MONKEY=y
CONFIG_LV_FONT_MONTSERRAT_10=y
```

## src/main.c
```c
/*
 * Copyright (c) 2018 Jan Van Winkel <jan.van_winkel@dxplore.eu>
 *
 * SPDX-License-Identifier: Apache-2.0
 */

#include <zephyr/device.h>
#include <zephyr/devicetree.h>
#include <zephyr/drivers/display.h>
#include <zephyr/drivers/gpio.h>

#include <stdio.h>
#include <string.h>
#include <zephyr/kernel.h>

#include "display.h"
#include "ui_helpers.h"

#define LOG_LEVEL CONFIG_LOG_DEFAULT_LEVEL
#include <zephyr/logging/log.h>
LOG_MODULE_REGISTER(app);


int main(void)
{
	ui_init();
	int i = 0;
	while (1)
	{
		switch(i)
		{
			case 0:
				lv_disp_load_scr(ui_mqttScreen);
				i = 1;
				break;
			case 1:
				lv_disp_load_scr(ui_lteScreen);
				i = 0;
				break;
			default:
				break;
		}
		lv_task_handler();
		k_sleep(K_MSEC(2000));
	}	
}
```

## include/display.h
```c
#ifndef __DISPLAY_H
#define __DISPLAY_H

#ifdef __cplusplus
extern "C"
{
#endif

#include <lvgl.h>

// SCREEN: ui_mqttScreen
void ui_mqttScreen_screen_init(void);
extern lv_obj_t *ui_mqttScreen;
extern lv_obj_t *ui_mqttTag;
extern lv_obj_t *ui_mqttStatus;
// SCREEN: ui_lteScreen
void ui_lteScreen_screen_init(void);
extern lv_obj_t *ui_lteScreen;
extern lv_obj_t *ui_lteTag;
extern lv_obj_t *ui_lteStatus;
extern lv_obj_t *ui____initial_actions0;
// SCREEN: ui_channelsScreen
void ui_channelsScreen_screen_init(void);
extern lv_obj_t *ui_channelsScreen;
extern lv_obj_t *ui_channelsTag;
extern lv_obj_t *ui_channelsStatus;
extern lv_obj_t *ui____initial_actions1;


void ui_init(void);

#ifdef __cplusplus
} /*extern "C"*/
#endif

#endif
```

## include/ui_helpers.h
```c
// This file was generated by SquareLine Studio
// SquareLine Studio version: SquareLine Studio 1.3.4
// LVGL version: 8.3.6
// Project name: ssd1306

#ifndef _SSD1306_UI_HELPERS_H
#define _SSD1306_UI_HELPERS_H

#ifdef __cplusplus
extern "C" {
#endif

#include "display.h"

#define _UI_TEMPORARY_STRING_BUFFER_SIZE 32
#define _UI_BAR_PROPERTY_VALUE 0
#define _UI_BAR_PROPERTY_VALUE_WITH_ANIM 1
void _ui_bar_set_property( lv_obj_t *target, int id, int val);

#define _UI_BASIC_PROPERTY_POSITION_X 0
#define _UI_BASIC_PROPERTY_POSITION_Y 1
#define _UI_BASIC_PROPERTY_WIDTH 2
#define _UI_BASIC_PROPERTY_HEIGHT 3
void _ui_basic_set_property( lv_obj_t *target, int id, int val);

#define _UI_DROPDOWN_PROPERTY_SELECTED 0
void _ui_dropdown_set_property( lv_obj_t *target, int id, int val);

#define _UI_IMAGE_PROPERTY_IMAGE 0
void _ui_image_set_property( lv_obj_t *target, int id, uint8_t *val);

#define _UI_LABEL_PROPERTY_TEXT 0
void _ui_label_set_property( lv_obj_t *target, int id, const char *val);

#define _UI_ROLLER_PROPERTY_SELECTED 0
#define _UI_ROLLER_PROPERTY_SELECTED_WITH_ANIM 1
void _ui_roller_set_property( lv_obj_t *target, int id, int val);

#define _UI_SLIDER_PROPERTY_VALUE 0
#define _UI_SLIDER_PROPERTY_VALUE_WITH_ANIM 1
void _ui_slider_set_property( lv_obj_t *target, int id, int val);

void _ui_screen_change( lv_obj_t ** target, lv_scr_load_anim_t fademode, int spd, int delay, void (*target_init)(void));

void _ui_screen_delete( lv_obj_t ** target );

void _ui_arc_increment( lv_obj_t *target, int val);

void _ui_bar_increment( lv_obj_t *target, int val, int anm);

void _ui_slider_increment( lv_obj_t *target, int val, int anm);

void _ui_keyboard_set_target( lv_obj_t *keyboard, lv_obj_t *textarea);

#define _UI_MODIFY_FLAG_ADD 0
#define _UI_MODIFY_FLAG_REMOVE 1
#define _UI_MODIFY_FLAG_TOGGLE 2
void _ui_flag_modify( lv_obj_t *target, int32_t flag, int value);

#define _UI_MODIFY_STATE_ADD 0
#define _UI_MODIFY_STATE_REMOVE 1
#define _UI_MODIFY_STATE_TOGGLE 2
void _ui_state_modify( lv_obj_t *target, int32_t state, int value);

void scr_unloaded_delete_cb(lv_event_t * e);

void _ui_opacity_set( lv_obj_t *target, int val);

/** Describes an animation*/
typedef struct _ui_anim_user_data_t {
    lv_obj_t *target;
    lv_img_dsc_t **imgset;
    int32_t imgset_size;
    int32_t val;
} ui_anim_user_data_t;
void _ui_anim_callback_free_user_data(lv_anim_t *a);

void _ui_anim_callback_set_x(lv_anim_t* a, int32_t v);

void _ui_anim_callback_set_y(lv_anim_t* a, int32_t v);

void _ui_anim_callback_set_width(lv_anim_t* a, int32_t v);

void _ui_anim_callback_set_height(lv_anim_t* a, int32_t v);

void _ui_anim_callback_set_opacity(lv_anim_t* a, int32_t v);

void _ui_anim_callback_set_image_zoom(lv_anim_t* a, int32_t v);

void _ui_anim_callback_set_image_angle(lv_anim_t* a, int32_t v);

void _ui_anim_callback_set_image_frame(lv_anim_t* a, int32_t v);

int32_t _ui_anim_callback_get_x(lv_anim_t* a);

int32_t _ui_anim_callback_get_y(lv_anim_t* a);

int32_t _ui_anim_callback_get_width(lv_anim_t* a);

int32_t _ui_anim_callback_get_height(lv_anim_t* a);

int32_t _ui_anim_callback_get_opacity(lv_anim_t* a);

int32_t _ui_anim_callback_get_image_zoom(lv_anim_t* a);

int32_t _ui_anim_callback_get_image_angle(lv_anim_t* a);

int32_t _ui_anim_callback_get_image_frame(lv_anim_t* a);

void _ui_arc_set_text_value( lv_obj_t *trg, lv_obj_t *src, const char *prefix, const char *postfix);

void _ui_slider_set_text_value( lv_obj_t *trg, lv_obj_t *src, const char *prefix, const char *postfix);

void _ui_checked_set_text_value( lv_obj_t *trg, lv_obj_t *src, const char *txt_on, const char *txt_off);

void _ui_spinbox_step(lv_obj_t * target, int val)
;

#ifdef __cplusplus
} /*extern "C"*/
#endif

#endif
```
